/**
 * example.syscfg — SysConfig script for the A53 SMP scheduler-latency build.
 *
 * Derived from the SDK's examples/kernel/freertos/smp_task_switch/am64x-evm/
 * a53ss0-0_freertos-smp/example.syscfg.  The makefile passes --context,
 * --package, --product and --compiler explicitly, so the @cliArgs line below is
 * informational; SysConfig will rewrite the @versions line on first load.
 *
 * What this asks for:
 *   - DPL configuration (ClockP tick timer, HwiP/GIC) with SDK defaults.
 *   - Debug log routed to UART0 (the XDS110 console) so DebugP_assert() and
 *     the SDK's own warnings are visible during bring-up.  The experiment's
 *     console.c writes the same UART's THR directly and does not use this
 *     driver; the driver open is what puts the UART into a known state
 *     independent of what the SBL left behind.  Baud is 921600 (13x
 *     oversampling: 48 MHz / 13 / 4 = 923077, 0.16 % error) because at
 *     115200 the console could carry only ~4 KB/s of the experiment's
 *     records and the log queue overflowed.  The SBL still prints at 115200,
 *     so a capture opened at 921600 sees garbage before the banner.
 *   - Three MMU regions.  Region 0 covers 0x00000000-0x7FFFFFFF with the
 *     module default attribute MAIR0 = Device-nGnRnE, which is what makes the
 *     polled UART writes at 0x02800000 legal (PORTING.md checklist A6).
 *     Regions 1 and 2 map MSRAM and DDR as normal cacheable memory (MAIR7).
 *
 * @cliArgs --device "AM64x" --package "ALV" --part "Default" --context "a53ss0-0" --product "MCU_PLUS_SDK@11.01.00"
 */

/**
 * Import the modules used in this configuration.
 */
const debug_log  = scripting.addModule("/kernel/dpl/debug_log");
const dpl_cfg    = scripting.addModule("/kernel/dpl/dpl_cfg");
const mmu_armv8  = scripting.addModule("/kernel/dpl/mmu_armv8", {}, false);
const mmu_armv81 = mmu_armv8.addInstance();
const mmu_armv82 = mmu_armv8.addInstance();
const mmu_armv83 = mmu_armv8.addInstance();

/**
 * Write custom configuration values to the imported modules.
 */
debug_log.enableCssLog         = false;
debug_log.enableUartLog        = true;
debug_log.uartLog.$name        = "CONFIG_UART_CONSOLE";
debug_log.uartLog.UART.$assign = "USART0";
debug_log.uartLog.baudRate     = 921600;
debug_log.uartLog.operMode     = "13X";

/* Peripheral window: device memory (module default attribute MAIR0). */
mmu_armv81.$name = "CONFIG_MMU_REGION0";
mmu_armv81.size  = 0x80000000;

/* MSRAM: normal, cacheable. */
mmu_armv82.$name     = "CONFIG_MMU_REGION1";
mmu_armv82.vAddr     = 0x70000000;
mmu_armv82.pAddr     = 0x70000000;
mmu_armv82.size      = 0x200000;
mmu_armv82.attribute = "MAIR7";

/* DDR: normal, cacheable.  Code, data, per-core stacks and the FreeRTOS heap
 * all live here (see linker.cmd). */
mmu_armv83.$name     = "CONFIG_MMU_REGION2";
mmu_armv83.vAddr     = 0x80000000;
mmu_armv83.pAddr     = 0x80000000;
mmu_armv83.size      = 0x80000000;
mmu_armv83.attribute = "MAIR7";

/**
 * Pinmux solution for unlocked pins/peripherals. This ensures that minor changes to the automatic solver in a future
 * version of the tool will not impact the pinmux you originally saw.  These lines can be completely deleted in order to
 * re-solve from scratch.
 */
debug_log.uartLog.UART.RXD.$suggestSolution = "UART0_RXD";
debug_log.uartLog.UART.TXD.$suggestSolution = "UART0_TXD";
